## conf/layer.conf
```bitbake
#
# Copyright (c) 2020-2024 Joel Winarske. All rights reserved.
#

# We have a conf and classes directory, append to BBPATH
BBPATH .= ":${LAYERDIR}"

BBFILES += " \
    ${LAYERDIR}/recipes*/*/*.bb \
    ${LAYERDIR}/recipes*/*/*.bbappend \
    ${LAYERDIR}/recipes*/*/*/*.bb \
    ${LAYERDIR}/recipes*/*/*/*.bbappend \
    ${LAYERDIR}/images/*.bb \
"

BBFILE_COLLECTIONS += "navi-layer"
BBFILE_PATTERN_flutter-layer := "^${LAYERDIR}/"
BBFILE_PRIORITY_navi-layer = "12"

LAYERRECOMMENDS_navi-layer = " \
    clang-layer \
"

BBFILES_DYNAMIC += " \
    clang-layer:${LAYERDIR}/dynamic-layers/clang-layer/*/*/*.bb \
    clang-layer:${LAYERDIR}/dynamic-layers/clang-layer/*/*/*/*.bb \
    clang-layer:${LAYERDIR}/dynamic-layers/clang-layer/*/*/*.bbappend \
"

BBFILE_COLLECTIONS += "meta-navi"
BBFILE_PATTERN_meta-navi = "${BBFILE_PATTERN_navi-layer}"
LAYERSERIES_COMPAT_meta-navi = "nanbield scarthgap"
```
